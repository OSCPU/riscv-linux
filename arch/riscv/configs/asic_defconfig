## arch/riscv/drivers/Kconfig
```kconfig
config ETH_XILINX_RV
	bool "Xilinx AXI dummy eth support for RV"
	depends on RISCV
	help
  Say 'Y' here if you want kernel to support the Xilinx AXI dummy eth driver.

config PCIE_XDMA_PL_RV
  bool "Xilinx XDMA PL PCIe host bridge support for RISC-V"
	depends on RISCV
	help
  Say 'Y' here if you want kernel to support the Xilinx XDMA PL PCIe Host Bridge driver for RISC-V.
```
